## config/boards/shields/sofle/Kconfig.defconfig
```kconfig
if SHIELD_SOFLE_LEFT

config ZMK_KEYBOARD_NAME
    default "Sofle Left"

endif

if SHIELD_SOFLE_RIGHT

config ZMK_KEYBOARD_NAME
    default "Sofle Right"

endif
```
